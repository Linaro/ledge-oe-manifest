## conf/bblayers.conf
```bitbake
# LAYER_CONF_VERSION is increased each time build/conf/bblayers.conf
# changes incompatibly
LCONF_VERSION = "7"
OEROOT := "${@os.path.abspath(os.path.dirname(d.getVar('FILE', True)))}/../.."

BBPATH = "${TOPDIR}"

BBFILES = ""

# These layers hold recipe metadata not found in OE-core, but lack any machine or distro content
BASELAYERS ?= " \
  ${OEROOT}/layers/meta-openembedded/meta-oe \
  ${OEROOT}/layers/meta-openembedded/meta-initramfs \
  ${OEROOT}/layers/meta-openembedded/meta-multimedia \
  ${OEROOT}/layers/meta-openembedded/meta-networking \
  ${OEROOT}/layers/meta-openembedded/meta-webserver \
  ${OEROOT}/layers/meta-openembedded/meta-filesystems \
  ${OEROOT}/layers/meta-openembedded/meta-python \
  ${OEROOT}/layers/meta-virtualization \
  ${OEROOT}/layers/meta-ledge/meta-ledge-sw \
  ${OEROOT}/layers/meta-clang \
  ${OEROOT}/layers/meta-rust \
"

# These layers hold machine specific content, aka Board Support Packages
BSPLAYERS ?= " \
  ${OEROOT}/layers/meta-freescale \
  ${OEROOT}/layers/meta-freescale-3rdparty \
  ${OEROOT}/layers/meta-ti \
"

# Add your overlay location to EXTRALAYERS
# Make sure to have a conf/layers.conf in there
EXTRALAYERS ?= " \
  ${OEROOT}/layers/meta-linaro/meta-linaro \
  ${OEROOT}/layers/meta-linaro/meta-optee \
  ${OEROOT}/layers/meta-updater/ \
  ${OEROOT}/layers/meta-selinux/ \
  ${OEROOT}/layers/meta-security/ \
  ${OEROOT}/layers/meta-secure-core/meta/ \
  ${OEROOT}/layers/meta-secure-core/meta-efi-secure-boot/ \
  ${OEROOT}/layers/meta-secure-core/meta-signing-key/ \
  ${OEROOT}/layers/meta-secure-core/meta-encrypted-storage/ \
  ${OEROOT}/layers/meta-secure-core/meta-tpm2/ \
  ${OEROOT}/layers/meta-cloud-services/ \
  ${OEROOT}/layers/meta-cloud-services/meta-openstack \
  ${OEROOT}/layers/meta-security/meta-tpm \
  ${OEROOT}/layers/meta-security/meta-parsec \
  ${OEROOT}/layers/meta-openembedded/meta-perl \
  ${OEROOT}/layers/meta-96boards \
  ${OEROOT}/layers/meta-arm/meta-arm \
  ${OEROOT}/layers/meta-arm/meta-arm-toolchain/ \
"

BBLAYERS = " \
  ${OEROOT}/layers/meta-rpb \
  ${BASELAYERS} \
  ${BSPLAYERS} \
  ${EXTRALAYERS} \
  ${OEROOT}/layers/openembedded-core/meta \
"
```
